/dts-v1/;
/plugin/;

/ {
    compatible = "brcm,bcm2711";

    fragment@0 {
        target-path = "/";
        __overlay__ {
            dht11@0 {
                compatible = "myvendor,dht11";
                gpios = <&gpio 4 0>;
                status = "okay";
            };
        };
    };
};
